#include "net/WifiPortal.h"
#include <ESPmDNS.h>
#include <Preferences.h>
#include <ArduinoJson.h>
#include <algorithm>
#include "AppPage.h"      // controller UI (station mode), generated by tools/build_pages.py
#include "PortalPage.h"   // setup page (AP mode)
#include "util/Util.h"

namespace {
constexpr uint32_t CONNECT_TIMEOUT_MS = 30000;   // saved network: give up and open the setup AP
constexpr uint32_t PRESCAN_TIMEOUT_MS = 20000;   // stop waiting for the first scan, open the AP anyway
constexpr uint32_t AP_RETRY_PERIOD_MS = 60000;   // setup AP: retry the saved network...
constexpr uint32_t AP_RETRY_WINDOW_MS = 15000;   // ...for this long, only while nobody is on the AP
constexpr uint32_t RESTART_DELAY_MS   = 1000;    // let the browser get the reply, then reboot
constexpr uint8_t  SCAN_MAX_RETRIES   = 3;
constexpr const char* AP_PREFIX = "Irrigation-Setup-";
// The setup AP's own subnet. Not 192.168.4.x (the SDK default): Android hotspots pick a random
// 192.168.x.0/24, and if the joined network used the AP's subnet the controller could not tell
// the two apart (Espressif FAQ). 10.73.0.x is not used by phones, routers or tethering.
constexpr uint8_t AP_IP[4] = {10, 73, 0, 1};
constexpr const char* AP_URL = "http://10.73.0.1/";

// Joining the chosen network from the setup page
constexpr uint32_t JOIN_START_MS    = 300;     // let the reply to /save go out first
constexpr uint32_t JOIN_TRY_MS      = 20000;   // one attempt: scan, auth, DHCP
constexpr uint8_t  JOIN_TRIES       = 2;       // a weak signal or a slow DHCP gets a second chance
constexpr uint32_t JOIN_GAP_MS      = 1000;
constexpr uint32_t DONE_DELAY_MS    = 800;     // "Finish": the reply reaches the phone before the AP goes
constexpr uint32_t LINGER_IDLE_MS   = 60000;   // joined: close the AP after a minute with nobody on it
constexpr uint32_t LINGER_MAX_MS    = 600000;  // ...and after 10 minutes in any case

// Written by the Wi-Fi event task, read in update(): single bytes, no locking needed
volatile uint8_t gDiscCount = 0, gDiscReason = 0;

uint32_t since(uint32_t t) { return (uint32_t)(millis() - t); }

// ---- validation (the server checks again whatever the page checked) ----
bool validUtf8(const String& s) {
  const uint8_t* p = (const uint8_t*)s.c_str();
  size_t n = s.length(), i = 0;
  while (i < n) {
    uint8_t c = p[i];
    size_t extra = c < 0x80 ? 0 : (c >= 0xC2 && c <= 0xDF) ? 1 : ((c & 0xF0) == 0xE0) ? 2 : (c >= 0xF0 && c <= 0xF4) ? 3 : 99;
    if (extra == 99) return false;
    if (extra > 0 && i + extra >= n) return false;   // cut off
    for (size_t j = 1; j <= extra; j++) if ((p[i + j] & 0xC0) != 0x80) return false;
    i += extra + 1;
  }
  return true;
}

// SSID: 1..32 bytes, valid UTF-8, no control characters
bool validSsid(const String& s) {
  if (s.length() < 1 || s.length() > 32) return false;
  for (size_t i = 0; i < s.length(); i++) {
    uint8_t c = (uint8_t)s[i];
    if (c < 0x20 || c == 0x7F) return false;
  }
  return validUtf8(s);
}

// Password: empty (open network) or 8..63 printable ASCII
bool validPass(const String& p) {
  if (p.length() == 0) return true;
  if (p.length() < 8 || p.length() > 63) return false;
  for (size_t i = 0; i < p.length(); i++) {
    uint8_t c = (uint8_t)p[i];
    if (c < 0x20 || c > 0x7E) return false;
  }
  return true;
}

const char* reasonText(uint8_t r) {
  switch (r) {
    case 2:   return "authentication expired";
    case 3:   return "the access point disconnected us";
    case 15:  return "4-way handshake timeout (wrong password?)";
    case 200: return "lost the signal";
    case 201: return "network not found (off? 5 GHz only? name typo?)";
    case 202: return "authentication failed (wrong password? WPA3-only?)";
    case 204: return "handshake timeout (wrong password?)";
    default:  return "other";
  }
}

// Wrong password, network gone, or no answer, from the reason of the failed attempt.
// 15: the router said the key was wrong (Espressif FAQ); 202: authentication refused (also WPA3-only);
// 204: our own handshake timeout, usually a wrong key as well; 201: not found on any channel.
char joinReason(uint8_t r) {
  if (r == 15 || r == 202 || r == 204) return 'p';
  if (r == 201) return 'n';
  return 't';
}
}  // namespace

void WifiPortal::onWifiEvent(arduino_event_id_t, arduino_event_info_t info) {
  static uint8_t last = 0;
  static uint32_t t = 0;
  uint8_t r = info.wifi_sta_disconnected.reason;
  if (r != 8) { gDiscReason = r; gDiscCount = gDiscCount + 1; }   // 8: we disconnected ourselves
  if (r == last && since(t) < 5000) return;   // the SDK retries every few seconds
  last = r;
  t = millis();
  Serial.printf("WiFi: not connected, reason %u: %s\n", (unsigned)r, reasonText(r));
}

// ---------------- lifecycle ----------------
void WifiPortal::begin(bool forceAp, const char* hostname) {
  copyStr(_host, sizeof(_host), hostname);
  WiFi.persistent(false);        // credentials live in our own NVS namespace
  WiFi.onEvent(onWifiEvent, ARDUINO_EVENT_WIFI_STA_DISCONNECTED);
  loadCreds();
  registerRoutes();

  Preferences p;                 // "Change WiFi network" from the UI asked for the setup AP
  bool setupReq = false;
  if (p.begin("wifi", false)) {
    setupReq = p.getUChar("setup", 0);
    if (setupReq) p.remove("setup");
    p.end();
  }

  if (forceAp) { Serial.println("WiFi: service mode, setup AP"); startAp(true); }
  else if (setupReq || _ssid.length() == 0) { Serial.println("WiFi: setup AP"); startAp(false); }
  else startSta();
}

void WifiPortal::update() {
  switch (_mode) {
    case Mode::CONNECTING:
      if (WiFi.status() == WL_CONNECTED) onConnected();
      else if (since(_tMode) >= CONNECT_TIMEOUT_MS) {
        Serial.println("WiFi: no connection within 30 s, opening the setup AP");
        _connectFailed = true;
        startAp(false);
      }
      break;
    case Mode::STA:
      trackConnection();
      _server.handleClient();
      break;
    case Mode::PRESCAN:
      pollScan();
      if (!_scanning) openAp();
      else if (since(_tMode) >= PRESCAN_TIMEOUT_MS) { _scanning = false; WiFi.scanDelete(); openAp(); }
      break;
    case Mode::AP:
      _dns.processNextRequest();
      _server.handleClient();
      pollScan();
      apRetry();
      joinStep();
      break;
    default:
      break;
  }
  if (_restartPending && (int32_t)(millis() - _restartAt) >= 0) restart("WiFi: restarting");
}

void WifiPortal::restart(const char* why) {
  Serial.println(why);
  delay(50);
  ESP.restart();
}

void WifiPortal::setHostname(const char* name) {
  copyStr(_host, sizeof(_host), name);
  if (_mode == Mode::STA) {
    WiFi.setHostname(_host);
    startMdns();
  }
}

void WifiPortal::resetToSetup() {
  Preferences p;
  if (p.begin("wifi", false)) { p.putUChar("setup", 1); p.end(); }
  _restartPending = true;
  _restartAt = millis() + RESTART_DELAY_MS;
}

// ---------------- credentials ----------------
void WifiPortal::loadCreds() {
  Preferences p;
  p.begin("wifi", false);
  _ssid = p.getString("ssid", "");
  _pass = p.getString("pass", "");
  p.end();
  if (!validSsid(_ssid) || !validPass(_pass)) { _ssid = ""; _pass = ""; }
}

bool WifiPortal::saveCreds(const String& ssid, const String& pass) {
  Preferences p;
  if (!p.begin("wifi", false)) return false;
  p.putString("ssid", ssid);
  p.putString("pass", pass);
  bool ok = p.getString("ssid", "") == ssid && p.getString("pass", "") == pass;
  p.end();
  return ok;
}

// ---------------- station ----------------
void WifiPortal::startSta() {
  _mode = Mode::CONNECTING;
  _tMode = millis();
  WiFi.mode(WIFI_STA);
  WiFi.setHostname(_host);            // after mode(STA), before begin
  WiFi.setSleep(false);               // mains powered: keeps mDNS and the page responsive
  WiFi.setAutoReconnect(true);
  WiFi.begin(_ssid.c_str(), _pass.c_str());
  Serial.printf("WiFi: connecting to \"%s\"\n", _ssid.c_str());
}

void WifiPortal::onConnected() {
  _mode = Mode::STA;
  ensureServer();
  startMdns();
  _wasUp = true;
  Serial.printf("WiFi: connected, IP %s, http://%s.local/\n", WiFi.localIP().toString().c_str(), _host);
  if (_onConnect) _onConnect();
}

void WifiPortal::trackConnection() {
  bool up = WiFi.status() == WL_CONNECTED;
  if (up && !_wasUp) {
    startMdns();
    Serial.printf("WiFi: reconnected, IP %s\n", WiFi.localIP().toString().c_str());
    if (_onConnect) _onConnect();
  } else if (!up && _wasUp) {
    Serial.println("WiFi: connection lost, retrying automatically");
  }
  _wasUp = up;
}

void WifiPortal::startMdns() {
  if (_mdnsOn) MDNS.end();
  _mdnsOn = MDNS.begin(_host);
  if (_mdnsOn) MDNS.addService("http", "tcp", 80);
}

// ---------------- setup access point ----------------
// Scan first with no AP running: once a phone is on the AP, scans fail or come back empty.
void WifiPortal::startAp(bool forced) {
  _apForced = forced;
  _retrying = false;
  _tRetry = millis();
  WiFi.disconnect(false, false);
  WiFi.mode(WIFI_STA);
  delay(100);                         // let the STA interface come up, otherwise the scan fails with -2
  WiFi.setSleep(false);
  WiFi.setAutoReconnect(false);       // background reconnect scans hop channels and drop AP clients
  _mode = Mode::PRESCAN;
  _tMode = millis();
  _scanRetries = 0;
  startScan();
}

// The radio has one channel: once the STA joins a network, the AP moves to that network's channel
// and phones on the AP may drop for a moment. Starting the AP on the strongest network's channel
// (most likely the one that will be chosen) usually avoids the move altogether.
uint8_t WifiPortal::apChannel() const {
  for (uint8_t i = 0; i < _netCount; i++)       // sorted, strongest first
    if (_nets[i].ch >= 1 && _nets[i].ch <= 11) return _nets[i].ch;   // 12-13: not every phone
  return 1;
}

uint8_t WifiPortal::channelOf(const String& ssid) const {
  for (uint8_t i = 0; i < _netCount; i++) if (_nets[i].ssid == ssid) return _nets[i].ch;
  return 0;                            // typed by hand: scan every channel
}

void WifiPortal::openAp() {
  WiFi.mode(WIFI_AP_STA);             // the STA half scans and joins while the AP stays up
  WiFi.setSleep(false);               // STA modem sleep makes the AP miss its clients
  uint8_t mac[6];
  WiFi.macAddress(mac);
  snprintf(_apName, sizeof(_apName), "%s%02X%02X", AP_PREFIX, mac[4], mac[5]);
  uint8_t ch = apChannel();
  WiFi.softAP(_apName, nullptr, ch, 0, 4);   // open, max 4 clients
  delay(200);
  const IPAddress ip(AP_IP[0], AP_IP[1], AP_IP[2], AP_IP[3]);
  WiFi.softAPConfig(ip, ip, IPAddress(255, 255, 255, 0));
  _dns.setErrorReplyCode(DNSReplyCode::NoError);
  _dns.start(53, "*", ip);            // captive portal: every name resolves to us
  _mode = Mode::AP;
  ensureServer();
  Serial.printf("WiFi: setup AP \"%s\" on channel %u, %s\n", _apName, (unsigned)ch, AP_URL);
}

// ---------------- joining the chosen network, AP still up ----------------
void WifiPortal::joinBegin() {
  _join = Join::CONNECTING;
  _jStart = millis();
  _jSeen = gDiscCount;
  WiFi.setHostname(_host);            // the name the router's device list shows
  WiFi.begin(_jSsid.c_str(), _jPass.length() ? _jPass.c_str() : nullptr, _jCh, nullptr, true);
  Serial.printf("WiFi: joining \"%s\" (channel %u, try %u)\n", _jSsid.c_str(), (unsigned)_jCh, (unsigned)_jTries + 1);
}

void WifiPortal::joinStep() {
  switch (_join) {
    case Join::WAIT:
      if (!_scanning && (int32_t)(millis() - _jAt) >= 0) joinBegin();
      break;
    case Join::CONNECTING: {
      if (WiFi.status() == WL_CONNECTED && (uint32_t)WiFi.localIP() != 0) { joinOk(); break; }
      uint8_t n = gDiscCount;
      bool ended = n != _jSeen, late = since(_jStart) >= JOIN_TRY_MS;
      if (!ended && !late) break;
      char why = ended ? joinReason(gDiscReason) : 't';
      if (_jErr != 'p') _jErr = why;   // a wrong key on any try is the answer
      if (++_jTries >= JOIN_TRIES) { joinFail(_jErr); break; }
      if (late) WiFi.disconnect(false, false);
      _join = Join::WAIT;
      _jAt = millis() + JOIN_GAP_MS;
      break;
    }
    case Join::OK:
      if (WiFi.softAPgetStationNum() > 0) _jClientAt = millis();
      if (_jDoneAt && (int32_t)(millis() - _jDoneAt) >= 0) goLive();
      else if (since(_jClientAt) >= LINGER_IDLE_MS || since(_jOkAt) >= LINGER_MAX_MS) goLive();
      break;
    default:
      break;
  }
}

void WifiPortal::joinOk() {
  if (!saveCreds(_jSsid, _jPass)) { joinFail('s'); return; }
  _ssid = _jSsid;
  _pass = _jPass;
  _jPass = "";
  _connectFailed = false;
  _jIp = WiFi.localIP().toString();
  _join = Join::OK;
  _jOkAt = _jClientAt = millis();
  _jDoneAt = 0;
  Serial.printf("WiFi: joined \"%s\", IP %s; setup AP stays up until Finish\n", _ssid.c_str(), _jIp.c_str());
}

void WifiPortal::joinFail(char why) {
  WiFi.disconnect(false, false);
  _join = Join::FAIL;
  _jErr = why;
  _jPass = "";
  _tRetry = millis();                 // no retry of the old network straight away
  Serial.printf("WiFi: could not join \"%s\" (%c)\n", _jSsid.c_str(), why);
}

// Close the AP and carry on in station mode on the connection we already have: the AP can be
// switched off without touching the STA connection (Espressif FAQ), so the IP shown stays valid.
void WifiPortal::goLive() {
  Serial.println("WiFi: setup done, closing the setup AP");
  _join = Join::NONE;
  _jDoneAt = 0;
  _retrying = false;
  _apForced = false;
  _dns.stop();
  WiFi.mode(WIFI_STA);
  WiFi.setSleep(false);
  WiFi.setAutoReconnect(true);
  if (WiFi.status() == WL_CONNECTED) { onConnected(); return; }
  _mode = Mode::CONNECTING;           // lost it meanwhile: the normal path takes over
  _tMode = millis();
  WiFi.begin(_ssid.c_str(), _pass.c_str());
}

// {"s":"idle"|"conn"|"ok"|"fail", "v":ssid, "ip":"x.x.x.x" (ok), "e":"pass"|"nf"|"to"|"save" (fail)}
void WifiPortal::joinJson(JsonObject o) const {
  static const char* const S[] = {"idle", "conn", "conn", "ok", "fail"};
  o["s"] = S[(uint8_t)_join];
  if (_join == Join::NONE) return;
  o["v"] = _jSsid;
  if (_join == Join::OK) o["ip"] = _jIp;
  if (_join == Join::FAIL) o["e"] = _jErr == 'p' ? "pass" : _jErr == 'n' ? "nf" : _jErr == 's' ? "save" : "to";
}

void WifiPortal::sendStatus() {
  JsonDocument d;
  joinJson(d.to<JsonObject>());
  d["h"] = _host;
  String out;
  serializeJson(d, out);
  sendJson(out);
}

// After a failed connection, with nobody on the AP, retry the saved network now and then
void WifiPortal::apRetry() {
  if (_apForced || _restartPending || _ssid.length() == 0) return;
  if (_join != Join::NONE && _join != Join::FAIL) return;   // the page is joining a network
  uint8_t clients = WiFi.softAPgetStationNum();
  if (!_retrying) {
    if (clients == 0 && !_scanning && since(_tRetry) >= AP_RETRY_PERIOD_MS) {
      WiFi.begin(_ssid.c_str(), _pass.c_str());
      _retrying = true;
      _tTry = millis();
    }
    return;
  }
  if (clients > 0) stopRetry();
  else if (WiFi.status() == WL_CONNECTED) restart("WiFi: saved network is back, restarting");
  else if (since(_tTry) >= AP_RETRY_WINDOW_MS) stopRetry();
}

void WifiPortal::stopRetry() {
  WiFi.disconnect(false, false);
  _retrying = false;
  _tRetry = millis();
}

// ---------------- scan (async) ----------------
void WifiPortal::startScan() {
  WiFi.scanDelete();
  WiFi.scanNetworks(true, false);
  _scanning = true;
}

void WifiPortal::resetRadio() {        // only before the AP exists: it would drop the phone
  WiFi.scanDelete();
  WiFi.mode(WIFI_OFF);
  delay(100);
  WiFi.mode(WIFI_STA);
  delay(100);
  WiFi.setSleep(false);
  WiFi.setAutoReconnect(false);
}

void WifiPortal::pollScan() {
  if (!_scanning) return;
  int n = WiFi.scanComplete();
  if (n == WIFI_SCAN_RUNNING) return;
  if (n <= 0 && _scanRetries < SCAN_MAX_RETRIES) {
    _scanRetries++;
    if (_mode == Mode::PRESCAN) resetRadio();
    startScan();
    return;
  }
  _scanning = false;
  if (n <= 0 && _netCount > 0) { WiFi.scanDelete(); return; }   // failed rescan: keep the old list
  collectNetworks(n);
  WiFi.scanDelete();
}

void WifiPortal::collectNetworks(int n) {
  _netCount = 0;
  for (int i = 0; i < n; i++) {
    String name = WiFi.SSID(i);
    if (!validSsid(name)) continue;    // hidden or odd names: typed by hand
    addNet(name, (int8_t)WiFi.RSSI(i), WiFi.encryptionType(i) == WIFI_AUTH_OPEN, (uint8_t)WiFi.channel(i));
  }
  std::sort(_nets, _nets + _netCount, [](const Net& a, const Net& b) { return a.rssi > b.rssi; });
}

void WifiPortal::addNet(const String& name, int8_t rssi, bool open, uint8_t ch) {
  for (uint8_t i = 0; i < _netCount; i++) {          // mesh: one row, the strongest access point's channel
    if (_nets[i].ssid != name) continue;
    if (rssi > _nets[i].rssi) { _nets[i].rssi = rssi; _nets[i].open = open; _nets[i].ch = ch; }
    return;
  }
  if (_netCount < MAX_NETS) _nets[_netCount++] = Net{name, rssi, open, ch};
}

// ---------------- web server ----------------
void WifiPortal::ensureServer() {
  if (_serverOn) return;
  _server.begin();
  _serverOn = true;
}

void WifiPortal::sendPage(const uint8_t* gz, size_t len, const char* cache) {
  _server.sendHeader("Content-Encoding", "gzip");
  _server.sendHeader("Cache-Control", cache);
  _server.send_P(200, "text/html; charset=utf-8", (PGM_P)gz, len);
}

void WifiPortal::registerRoutes() {
  // "/" is the setup page in AP mode, otherwise the controller UI
  _server.on("/", HTTP_GET, [this]() {
    if (_mode == Mode::AP) sendPage(PORTAL_GZ, PORTAL_GZ_LEN, "no-store");   // a cached copy would greet name.local later
    else sendPage(APP_GZ, APP_GZ_LEN, "max-age=60");   // short: a firmware update ships a new page
  });
  _server.on("/health", HTTP_GET, [this]() {
    _server.sendHeader("Cache-Control", "no-store");
    _server.send(200, "text/plain; charset=utf-8", _health ? _health() : String("ok\n"));
  });
  _server.on("/ping", HTTP_GET, [this]() {
    _server.sendHeader("Access-Control-Allow-Origin", "*");
    _server.send(200, "text/plain", _mode == Mode::AP ? "ap" : "ok");
  });
  _server.on("/favicon.ico", HTTP_GET, [this]() { _server.send(204); });

  // Phones probe these to detect a captive portal; a redirect opens the setup page
  for (const char* probe : {"/generate_204", "/gen_204", "/hotspot-detect.html", "/library/test/success.html",
                            "/connecttest.txt", "/ncsi.txt", "/redirect", "/canonical.html"}) {
    _server.on(probe, HTTP_GET, [this]() { if (_mode == Mode::AP) redirectHome(); else notFound(); });
  }
  _server.on("/scan", HTTP_GET, [this]() { if (_mode == Mode::AP) sendScan(); else notFound(); });
  _server.on("/rescan", HTTP_GET, [this]() {
    if (_mode != Mode::AP) { notFound(); return; }
    if (_join == Join::WAIT || _join == Join::CONNECTING) { _server.send(200, "text/plain", "busy"); return; }
    if (_join != Join::NONE) { if (_join == Join::OK) WiFi.disconnect(false, false); _join = Join::NONE; }
    if (_retrying) stopRetry();
    _scanRetries = 0;
    startScan();
    _server.send(200, "text/plain", "ok");
  });
  _server.on("/save", HTTP_POST, [this]() { handleSave(); });
  _server.on("/status", HTTP_GET, [this]() { if (_mode == Mode::AP) sendStatus(); else notFound(); });
  _server.on("/done", HTTP_POST, [this]() {
    if (_mode != Mode::AP) { notFound(); return; }
    if (_join != Join::OK) { sendJson("{\"e\":\"state\"}"); return; }
    _jDoneAt = millis() + DONE_DELAY_MS;
    sendJson("{\"ok\":1}");
  });

  if (_routes) _routes(_server);     // the controller API (refuses to answer outside station mode)

  _server.onNotFound([this]() { if (_mode == Mode::AP) redirectHome(); else notFound(); });
}

void WifiPortal::notFound() { _server.send(404, "text/plain", "not found"); }

void WifiPortal::redirectHome() {
  _server.sendHeader("Location", AP_URL, true);
  _server.sendHeader("Cache-Control", "no-store");
  _server.send(302, "text/plain", "");
}

void WifiPortal::sendJson(const String& j) {
  _server.sendHeader("Cache-Control", "no-store");
  _server.send(200, "application/json", j);
}

// {"w":1} while scanning, else {"w":0,"f":0|1,"v":saved ssid,"n":[{"s","r","o"}]}; always "h":hostname,
// "a":AP name and "j": the join state, so a reopened page picks up where it was
void WifiPortal::sendScan() {
  JsonDocument d;
  joinJson(d["j"].to<JsonObject>());
  d["a"] = _apName;
  d["h"] = _host;
  if (_scanning) {
    d["w"] = 1;
  } else {
    d["w"] = 0;
    d["f"] = _connectFailed ? 1 : 0;
    d["v"] = _ssid;
    JsonArray n = d["n"].to<JsonArray>();
    for (uint8_t i = 0; i < _netCount; i++) {
      JsonObject o = n.add<JsonObject>();
      o["s"] = _nets[i].ssid;
      o["r"] = _nets[i].rssi;
      o["o"] = _nets[i].open ? 1 : 0;
    }
  }
  String out;
  serializeJson(d, out);
  sendJson(out);
}

void WifiPortal::handleSave() {
  if (_mode != Mode::AP) { notFound(); return; }
  String ssid = _server.arg("ssid");
  ssid.trim();                         // stray spaces from keyboards; the password is never trimmed
  String pass = _server.arg("pass");
  if (!validSsid(ssid)) { sendJson("{\"e\":\"ssid\"}"); return; }
  if (!validPass(pass)) { sendJson("{\"e\":\"pass\"}"); return; }
  if (_join == Join::WAIT || _join == Join::CONNECTING) { sendJson("{\"e\":\"busy\"}"); return; }
  if (_retrying) stopRetry();
  if (_join == Join::OK) WiFi.disconnect(false, false);   // joined already, now another network
  _jSsid = ssid;
  _jPass = pass;
  _jCh = channelOf(ssid);
  _jTries = 0;
  _jErr = 0;
  _jIp = "";
  _join = Join::WAIT;                  // saved only once the join works: a typo keeps the old network
  _jAt = millis() + JOIN_START_MS;
  sendJson("{\"ok\":1}");
}
